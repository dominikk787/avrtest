const unsigned char PROGMEM font[CHAR_COUNT8][FONT_WIDTH]=
{
{0x08,0x3E,0x22,0x22,0x3E,0x08},	/*(01) 0x00 Resistor3  */                    
{0x08,0x7F,0x22,0x14,0x08,0x7F},	/*     0x01 Diode1  */                       
{0x7F,0x08,0x14,0x22,0x7F,0x08},	/*     0x02 Diode2  */                       
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{0x00,0x3C,0x26,0x23,0x26,0x3C},	/* 0x7f  */                                                                                                                                     
};

#define CMD_CLEAR	0x01		/* clear display, basic Instruction */
#define CMD_CGRAM_SELECT 0x02		/* SR=0, enable CGRAM address */
#define CMD_SET_ENTRY_MODE 0x04		/* set cursor posistion and shift for read/write */
#define MODE_RIGHT_MOVE 0x02
#define CMD_DISPLAY_CONTROL	0x08	/* display control, basic Instruction */
#define DISPLAY_ON 0x4
#define CURSOR_ON 0x02
#define BLINK_ON 0x01
#define CMD_DISPLAY_ON	(CMD_DISPLAY_CONTROL | DISPLAY_ON)
#define CMD_DISPLAY_OFF	CMD_DISPLAY_CONTROL
#define CMD_SET_FUNCTION 0x20		/* basic + extended Instruction */
#define MODE_8_BIT 0x10		/* Bit 4 is 8 bit mode */
#define MODE_EXTENDED 0x04		/* Bit 2 is used for extended Intruction */
#define GRAPHIC_DISPLAY_ON 0x02	/* Bit 1 is used for graphic display on, only extended Instruction */
#define CMD_SET_GDRAM_ADDRESS 0x80	/* set graphic display RAM address ,extended Instruction */

uint8_t lcd_bit_mem[SCREEN_HEIGHT][SCREEN_WIDTH / 8];

void lcd_set_pixels(const unsigned char *pdata, unsigned char x, unsigned char y,
	unsigned char width, unsigned char height) {
	unsigned char ii,hh,hmsk;
	unsigned char jj;
	unsigned char xx,xxbit;
	unsigned char ymem;
	if (((x+width) > 128) || ((y+height) > 64)) return;
	for (ii=0; ii<height; ii++) {
		hh = ii / 8;
		hmsk = pgm_read_byte(set_msk + (ii % 8));
		for (jj=0; jj<width; jj++) {
			xx = (x + jj) / 8;
			xxbit = (x + jj) % 8;
			ymem = y + ii;
			if ((pgm_read_byte(pdata + jj + (hh*width)) & hmsk) == 0) {
				// clear bit in the pixel image
				lcd_bit_mem[ymem][xx] &= pgm_read_byte(clear_msk+(7-xxbit));
			} else {
				// set bit in the pixel image
				lcd_bit_mem[ymem][xx] |= pgm_read_byte(set_msk+(7-xxbit));
			}
		} /* end for jj */
	} /* end for ii */
}

void lcd_data(unsigned char temp1) {
/* -------------------------------------------------------------------------- */
	_lcd_column++;
	 uint8_t *pfont;
	 pfont = (uint8_t *)font + (FONT_WIDTH * temp1);	// first byte of character data
	 // for other controllers like ST7565 the _page specifies the page of the controller (8 lines)
	 lcd_set_pixels( pfont, _xpos, _page*8, (unsigned char)FONT_WIDTH, (unsigned char)8);
	_xpos += FONT_WIDTH;		// move pointer to the next character position
} /* end lcd_data() */

void lcd_refresh(void) {
	unsigned char xx;
	unsigned char yy, yyo;
	for (yy=0; yy<64; yy++) {
		yyo = (yy + LCD_ST7565_Y_START) & 0x3f;	/* the y-address with offset */
		if (yyo < 32) {
			lcd_command(CMD_SET_GDRAM_ADDRESS|yyo);	/* set vertical start address */
			lcd_command(CMD_SET_GDRAM_ADDRESS|0);	/* horizontal address starts with 0 */
		} else {
			// the second half of display is located at GDRAM address 128..255 ((8..15) x 16 pixel)
			lcd_command(CMD_SET_GDRAM_ADDRESS|(yyo-32));	/* set vertical start address */
			lcd_command(CMD_SET_GDRAM_ADDRESS|(SCREEN_WIDTH / 16));	/* horizontal address starts with 0 (128)*/
		}
		for (xx=0; xx<(128 / 8); xx++) {
			lcd_write_data(lcd_bit_mem[yy][xx]);	// write 16 x 8 bits to GDRAM (= 128 pixel)
		}
	} /* end for yy */
}